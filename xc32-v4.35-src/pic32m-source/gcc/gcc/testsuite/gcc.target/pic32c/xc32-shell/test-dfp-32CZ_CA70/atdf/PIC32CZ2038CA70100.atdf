# PIC32CZ2038CA70100 device description
Architecture: CORTEX-M7; Family: PIC32CZ; Series: CA70
Parameters: __CM7_REV=0x0101 (CM7 Core Revision), __NVIC_PRIO_BITS=3 (Number of Bits used for Priority Levels), __Vendor_SysTickConfig=0 (Set to 1 if different SysTick Config is used), __MPU_PRESENT=1 (MPU present or not), __VTOR_PRESENT=1 (Vector Table Offset Register present or not), __FPU_PRESENT=1 (FPU present or not), __FPU_DP=1 (Double Precision FPU), __ICACHE_PRESENT=1 (Instruction Cache present), __DCACHE_PRESENT=1 (Data Cache present), __ITCM_PRESENT=1 (Instruction TCM present), __DTCM_PRESENT=1 (Data TCM present), LITTLE_ENDIAN=1, NUM_IRQ=68, __ARCH_ARM=1, __ARCH_ARM_CORTEX_M=1, __DEVICE_IS_PIC32C=1
Programming and debug interfaces: JTAG, SWD
Registers are 32-bit, read-write, no defined reset value unless marked. A register's access mark holds for its fields unless they carry their own. Offsets are from the block's base; lines under a group give offsets from that group; [hi:lo] are bit positions; {n}, {i} and the like mark numbered series; 'fields as' and 'values as' point back to an identical list; <NAME> marks a mode.

## Ordering variants
PIC32CZ2038CA70100-CB: TFBGA100, up to 300 MHz, -40 to +105 C, 1.62 to 3.6 V
PIC32CZ2038CA70100-AAB: LQFP100, up to 300 MHz, -40 to +105 C, 1.62 to 3.6 V

## Memory
base space: start 0 size 0x100000000, little endian
  0x40000000 PERIPHERALS size 0x20000000 io, rw
  0xE0000000 SYSTEM size 0x10000000 io, rw
  0x80000000 QSPIMEM size 0x20000000 other, rw, executable
  0xA0000000 AXIMX size 0x00100000 other, rw
  0x00000000 ITCM size 0x00200000 other, rw, executable
  0x00400000 IFLASH size 0x00200000 flash, rw, executable, page 512
  0x00800000 IROM size 0x00004000 rom, executable
  0x20000000 DTCM size 0x00020000 other, rw, executable
  0x20400000 IRAM size 0x00060000 ram, rw, executable
fuses space: start 0 size 2, little endian
lockbits space: start 0 size 0x10, little endian

## Peripheral instances (address, pins/pin function, parameters)
ACC at 0x40044000
  parameters: INSTANCE_ID=33, CLOCK_ID=33
AES at 0x4006C000
  parameters: DMAC_ID_TX=37, DMAC_ID_RX=38, INSTANCE_ID=56, CLOCK_ID=56
AFEC0 at 0x4003C000 (AFEC)
  pins: AFEC0_ADTRG PA8/B; AFEC0_AD0 PD30/X1; AFEC0_AD1 PA21/X1; AFEC0_AD2 PB3/X1; AFEC0_AD3 PE5/X1; AFEC0_AD4 PE4/X1; AFEC0_AD5 PB2/X1; AFEC0_AD6 PA17/X1; AFEC0_AD7 PA18/X1; AFEC0_AD8 PA19/X1; AFEC0_AD9 PA20/X1; AFEC0_AD10 PB0/X1
  parameters: DMAC_ID_RX=35, INSTANCE_ID=29, CLOCK_ID=29
AFEC1 at 0x40064000 (AFEC)
  pins: AFEC1_ADTRG PD9/C; AFEC1_AD0 PB1/X1; AFEC1_AD1 PC13/X1; AFEC1_AD2 PC15/X1; AFEC1_AD3 PC12/X1; AFEC1_AD4 PC29/X1; AFEC1_AD5 PC30/X1; AFEC1_AD6 PC31/X1; AFEC1_AD7 PC26/X1; AFEC1_AD8 PC27/X1; AFEC1_AD9 PC0/X1; AFEC1_AD10 PE3/X1; AFEC1_AD11 PE0/X1
  parameters: DMAC_ID_RX=36, INSTANCE_ID=40, CLOCK_ID=40
CHIPID at 0x400E0940
EFC at 0x400E0C00
  parameters: FLASH_SIZE=2097152, PAGE_SIZE=512, INSTANCE_ID=6, PAGES_PR_REGION=32
GMAC at 0x40050000
  pins: GCOL PD13/A; GCRS PD10/A; GMDC PD8/A; GMDIO PD9/A; GRXCK PD14/A; GRXDV PD4/A; GRXER PD7/A; GRX0 PD5/A; GRX1 PD6/A; GRX2 PD11/A; GRX3 PD12/A; GTSUCOMP PB1/B or PB12/B or PD11/C or PD20/C; GTXCK PD0/A; GTXEN PD1/A; GTXER PD17/A; GTX0 PD2/A; GTX1 PD3/A; GTX2 PD15/A; GTX3 PD16/A
  parameters: INSTANCE_ID=39, CLOCK_ID=39
GPBR at 0x400E1890
HSMCI at 0x40000000
  pins: MCCDA PA28/C; MCCK PA25/D; MCDA0 PA30/C; MCDA1 PA31/C; MCDA2 PA26/C; MCDA3 PA27/C
  parameters: DMAC_ID_RX=0, DMAC_ID_TX=0, INSTANCE_ID=18, CLOCK_ID=18
I2SC0 at 0x4008C000 (I2SC)
  pins: I2SC0_CK PA1/D; I2SC0_DI PA16/D; I2SC0_DO PA30/D; I2SC0_MCK PA0/D; I2SC0_WS PA15/D
  parameters: INSTANCE_ID=69, CLOCK_ID=69
I2SC1 at 0x40090000 (I2SC)
  pins: I2SC1_CK PA20/D; I2SC1_DI PE2/C; I2SC1_DO PE1/C; I2SC1_MCK PA19/D; I2SC1_WS PE0/C
  parameters: INSTANCE_ID=70, CLOCK_ID=70
ICM at 0x40048000
  parameters: INSTANCE_ID=32, CLOCK_ID=32
ISI at 0x4004C000
  pins: ISI_D0 PD22/D; ISI_D1 PD21/D; ISI_D2 PB3/D; ISI_D3 PA9/B; ISI_D4 PA5/B; ISI_D5 PD11/D; ISI_D6 PD12/D; ISI_D7 PA27/D; ISI_D8 PD27/D; ISI_D9 PD28/D; ISI_D10 PD30/D; ISI_D11 PD31/D; ISI_HSYNC PD24/D; ISI_PCK PA24/D; ISI_VSYNC PD25/D
  parameters: INSTANCE_ID=59, CLOCK_ID=59
MATRIX at 0x40088000
MCAN0 at 0x40030000 (MCAN)
  pins: CANRX0 PB3/A; CANTX0 PB2/A
  parameters: INSTANCE_ID=35, CLOCK_ID=35
MCAN1 at 0x40034000 (MCAN)
  pins: CANRX1 PC12/C or PD28/B; CANTX1 PC14/C or PD12/B
  parameters: INSTANCE_ID=37, CLOCK_ID=37
MLB at 0x40068000
  pins: MLBCLK PB4/C; MLBDAT PB5/C; MLBSIG PD10/D
  parameters: INSTANCE_ID=53, CLOCK_ID=53
PORTA at 0x400E0E00 (PORT)
  pins: P{n} PA{n} (n=0..31)
  parameters: DMAC_ID_RX=34, INSTANCE_ID=10, CLOCK_ID=10
PORTB at 0x400E1000 (PORT)
  pins: P{n} PB{n-32} (n=32..41); P44 PB12; P45 PB13
  parameters: INSTANCE_ID=11, CLOCK_ID=11
PORTD at 0x400E1400 (PORT)
  pins: P{n} PD{n-96} (n=96..127)
  parameters: INSTANCE_ID=16, CLOCK_ID=16
PMC at 0x400E0600
  pins: PCK0 PA6/B or PB12/D or PB13/B; PCK1 PA17/B or PA21/B; PCK2 PA3/C or PA18/B or PA31/B or PB3/B or PD31/C
  parameters: INSTANCE_ID=5
PWMC0 at 0x40020000 (PWMC)
  pins: PWMC0_PWMEXTRG0 PA10/B; PWMC0_PWMEXTRG1 PA22/B; PWMC0_PWMFI0 PA9/C; PWMC0_PWMFI1 PD8/B; PWMC0_PWMFI2 PD9/B; PWMC0_PWMH0 PA0/A or PA11/B or PA23/B or PB0/A or PD11/B or PD20/A; PWMC0_PWMH1 PA2/A or PA12/B or PA24/B or PB1/A or PD21/A; PWMC0_PWMH2 PA13/B or PA25/B or PB4/B or PC19/B or PD22/A; PWMC0_PWMH3 PA7/B or PA14/B or PA17/C or PC13/B or PC21/B or PD23/A; PWMC0_PWML0 PA1/A or PA19/B or PB5/B or PC0/B or PD10/B or PD24/A; PWMC0_PWML1 PA20/B or PB12/A or PC1/B or PC18/B or PD25/A; PWMC0_PWML2 PA16/C or PA30/A or PB13/A or PC2/B or PC20/B or PD26/A; PWMC0_PWML3 PA15/C or PC3/B or PC15/B or PC22/B or PD27/A
  parameters: DMAC_ID_TX=13, INSTANCE_ID=31, CLOCK_ID=31
PWMC1 at 0x4005C000 (PWMC)
  pins: PWMC1_PWMEXTRG0 PA30/B; PWMC1_PWMEXTRG1 PA18/A; PWMC1_PWMFI0 PA21/C; PWMC1_PWMFI1 PA26/D; PWMC1_PWMFI2 PA28/D; PWMC1_PWMH0 PA12/C or PD1/B; PWMC1_PWMH1 PA14/C or PD3/B; PWMC1_PWMH2 PA31/D or PD5/B; PWMC1_PWMH3 PA8/A or PD7/B; PWMC1_PWML0 PA11/C or PD0/B; PWMC1_PWML1 PA13/C or PD2/B; PWMC1_PWML2 PA23/D or PD4/B; PWMC1_PWML3 PA5/A or PD6/B
  parameters: DMAC_ID_TX=39, INSTANCE_ID=60, CLOCK_ID=60
QSPI at 0x4007C000
  pins: QCS PA11/A; QIO0 PA13/A; QIO1 PA12/A; QIO2 PA17/A; QIO3 PD31/A; QSCK PA14/A
  parameters: DMAC_ID_RX=6, DMAC_ID_TX=5, INSTANCE_ID=43, CLOCK_ID=43
RSTC at 0x400E1800
  parameters: INSTANCE_ID=1
RSWDT at 0x400E1900
  parameters: INSTANCE_ID=63
RTC at 0x400E1860
  pins: RTCOUT0 PB0/X1; RTCOUT1 PB1/X1
  parameters: INSTANCE_ID=2
RTT at 0x400E1830
  parameters: INSTANCE_ID=3
SPI0 at 0x40008000 (SPI)
  pins: SPI0_MISO PD20/B; SPI0_MOSI PD21/B; SPI0_NPCS0 PB2/D; SPI0_NPCS1 PA31/A or PD25/B; SPI0_NPCS2 PD12/C; SPI0_NPCS3 PD27/B; SPI0_SPCK PD22/B
  parameters: DMAC_ID_RX=2, DMAC_ID_TX=1, INSTANCE_ID=21, CLOCK_ID=21
SPI1 at 0x40058000 (SPI)
  pins: SPI1_MISO PC26/C; SPI1_MOSI PC27/C; SPI1_NPCS0 PC25/C; SPI1_NPCS1 PC28/C or PD0/C; SPI1_NPCS2 PC29/C or PD1/C; SPI1_NPCS3 PC30/C or PD2/C; SPI1_SPCK PC24/C
  parameters: DMAC_ID_RX=4, DMAC_ID_TX=3, INSTANCE_ID=42, CLOCK_ID=42
SSC at 0x40004000
  pins: RD PA10/C; RF PD24/B; RK PA22/A; TD PB5/D or PD10/C or PD26/B; TF PB0/D; TK PB1/D
  parameters: DMAC_ID_RX=33, DMAC_ID_TX=32, INSTANCE_ID=22, CLOCK_ID=22
SUPC at 0x400E1810
  parameters: INSTANCE_ID=0
TC0 at 0x4000C000 (TC)
  pins: TCLK0 PA4/B; TCLK1 PA28/B; TCLK2 PA29/B; TIOA0 PA0/B; TIOA1 PA15/B; TIOA2 PA26/B; TIOB0 PA1/B; TIOB1 PA16/B; TIOB2 PA27/B
  parameters: DMAC_ID_RX=40, INSTANCE_ID_CHANNEL0=23, INSTANCE_ID_CHANNEL1=24, INSTANCE_ID_CHANNEL2=25
TC1 at 0x40010000 (TC)
  pins: TCLK3 PC25/B; TCLK4 PC28/B; TCLK5 PC31/B; TIOA3 PC23/B; TIOA4 PC26/B; TIOA5 PC29/B; TIOB3 PC24/B; TIOB4 PC27/B; TIOB5 PC30/B
  parameters: DMAC_ID_RX=41, INSTANCE_ID_CHANNEL0=26, INSTANCE_ID_CHANNEL1=27, INSTANCE_ID_CHANNEL2=28
TC2 at 0x40014000 (TC)
  pins: TCLK6 PC7/B; TCLK7 PC10/B; TCLK8 PC14/B; TIOA6 PC5/B; TIOA7 PC8/B; TIOA8 PC11/B; TIOB6 PC6/B; TIOB7 PC9/B; TIOB8 PC12/B
  parameters: DMAC_ID_RX=42, INSTANCE_ID_CHANNEL0=47, INSTANCE_ID_CHANNEL1=48, INSTANCE_ID_CHANNEL2=49
TC3 at 0x40054000 (TC)
  pins: TCLK9 PE2/B; TCLK10 PE5/B; TCLK11 PD24/C; TIOA9 PE0/B; TIOA10 PE3/B; TIOA11 PD21/C; TIOB9 PE1/B; TIOB10 PE4/B; TIOB11 PD22/C
  parameters: DMAC_ID_RX=43, INSTANCE_ID_CHANNEL0=50, INSTANCE_ID_CHANNEL1=51, INSTANCE_ID_CHANNEL2=52
TRNG at 0x40070000
  parameters: INSTANCE_ID=57, CLOCK_ID=57
TWI0 at 0x40018000 (TWI)
  pins: TWCK0 PA4/A; TWD0 PA3/A
  parameters: DMAC_ID_RX=15, DMAC_ID_TX=14, INSTANCE_ID=19, CLOCK_ID=19
TWI1 at 0x4001C000 (TWI)
  pins: TWCK1 PB5/A; TWD1 PB4/A
  parameters: DMAC_ID_RX=17, DMAC_ID_TX=16, INSTANCE_ID=20, CLOCK_ID=20
TWI2 at 0x40060000 (TWI)
  pins: TWCK2 PD28/C; TWD2 PD27/C
  parameters: DMAC_ID_RX=19, DMAC_ID_TX=18, INSTANCE_ID=41, CLOCK_ID=41
UART0 at 0x400E0800 (UART)
  pins: URXD0 PA9/A; UTXD0 PA10/A
  parameters: DMAC_ID_RX=21, DMAC_ID_TX=20, INSTANCE_ID=7, CLOCK_ID=7
UART1 at 0x400E0A00 (UART)
  pins: URXD1 PA5/C; UTXD1 PA4/C or PA6/C or PD26/D
  parameters: DMAC_ID_RX=23, DMAC_ID_TX=22, INSTANCE_ID=8, CLOCK_ID=8
UART2 at 0x400E1A00 (UART)
  pins: URXD2 PD25/C; UTXD2 PD26/C
  parameters: DMAC_ID_RX=25, DMAC_ID_TX=24, INSTANCE_ID=44, CLOCK_ID=44
UART3 at 0x400E1C00 (UART)
  pins: URXD3 PD28/A; UTXD3 PD30/A or PD31/B
  parameters: DMAC_ID_RX=27, DMAC_ID_TX=26, INSTANCE_ID=45, CLOCK_ID=45
UART4 at 0x400E1E00 (UART)
  pins: URXD4 PD18/C; UTXD4 PD3/C or PD19/C
  parameters: DMAC_ID_RX=29, DMAC_ID_TX=28, INSTANCE_ID=46, CLOCK_ID=46
USART0 at 0x40024000 (USART)
  pins: CTS0 PB2/C; DCD0 PD0/D; DSR0 PD2/D; DTR0 PD1/D; RI0 PD3/D; RTS0 PB3/C; RXD0 PB0/C; SCK0 PB13/C; TXD0 PB1/C
  parameters: DMAC_ID_RX=8, DMAC_ID_TX=7, INSTANCE_ID=13, CLOCK_ID=13
USART1 at 0x40028000 (USART)
  pins: CTS1 PA25/A; DCD1 PA26/A; DSR1 PA28/A; DTR1 PA27/A; LONCOL1 PA3/B; RI1 PA29/A; RTS1 PA24/A; RXD1 PA21/A; SCK1 PA23/A; TXD1 PB4/D
  parameters: DMAC_ID_RX=10, DMAC_ID_TX=9, INSTANCE_ID=14, CLOCK_ID=14
USART2 at 0x4002C000 (USART)
  pins: CTS2 PD19/B; DCD2 PD4/D; DSR2 PD6/D; DTR2 PD5/D; RI2 PD7/D; RTS2 PD18/B; RXD2 PD15/B; SCK2 PD17/B; TXD2 PD16/B
  parameters: DMAC_ID_RX=12, DMAC_ID_TX=11, INSTANCE_ID=15, CLOCK_ID=15
USBHS at 0x40038000
  parameters: INSTANCE_ID=34, CLOCK_ID=34
UTMI at 0x400E0400
WDT at 0x400E1850
  parameters: INSTANCE_ID=4
XDMAC at 0x40078000
  parameters: INSTANCE_ID=58, CLOCK_ID=58
FUSES at GPNVMBITS 0 in fuses
LOCKBIT at 0 in lockbits
SystemControl at 0xE000E000
SysTick at 0xE000E010
NVIC at 0xE000E100
MPU at 0xE000ED90
FPU at 0xE000EF34
OSCILLATOR
  pins: XIN PB9/X1; XOUT PB8/X1; XIN32 PA7/X1; XOUT32 PA8/X1
PORT
  pins: PORTDC0 PA3/X1; PORTDC1 PA4/X1; PORTDC2 PA5/X1; PORTDC3 PA9/X1; PORTDC4 PA10/X1; PORTDC5 PA11/X1; PORTDC6 PA12/X1; PORTDC7 PA13/X1; PORTDCEN1 PA14/X1; PORTDCEN2 PA21/X1; PORTDCCLK PA22/X1
DEBUG
  pins: TDI PB4/X1; TDO PB5/X1; TRACESWO PB5/X1; TMS PB6/X1; SWDIO PB6/X1; TCK PB7/X1; SWDCLK PB7/X1
FLASH
  pins: ERASE PB12/X1
TRACE
  pins: TRACECLK PD8/D; TRACED0 PD4/C; TRACED1 PD5/C; TRACED2 PD6/C; TRACED3 PD7/C
WKUP
  pins: WKUP0 PA0/X1; WKUP1 PA1/X1; WKUP2 PA2/X1; WKUP3 PA4/X1; WKUP4 PA5/X1; WKUP5 PD28/X1; WKUP6 PA9/X1; WKUP7 PA11/X1; WKUP8 PA14/X1; WKUP9 PA19/X1; WKUP10 PA20/X1; WKUP11 PA30/X1; WKUP12 PB3/X1; WKUP13 PB5/X1

## Interrupts
-15 Reset — Reset Vector, invoked on Power up and warm reset
-14 NonMaskableInt — Non maskable Interrupt, cannot be stopped or preempted
-13 HardFault — Hard Fault, all classes of Fault
-12 MemoryManagement — Memory Management, MPU mismatch, including Access Violation and No Match
-11 BusFault — Bus Fault, Pre-Fetch-, Memory Access Fault, other address/memory related Fault
-10 UsageFault — Usage Fault, i.e. Undef Instruction, Illegal State Transition
-5 SVCall — System Service Call via SVC instruction
-4 DebugMonitor
-2 PendSV — Pendable request for system service
-1 SysTick — System Tick Timer
0 SUPC — Supply Controller
1 RSTC — Reset Controller
2 RTC — Real Time Clock
3 RTT — Real Time Timer
4 WDT — Watchdog Timer
5 PMC — Power Management Controller
6 EFC — Enhanced Embedded Flash Controller
7 UART0
8 UART1
10 PORTA
11 PORTB
13 USART0
14 USART1
15 USART2
16 PORTD
18 HSMCI — Multimedia Card Interface
19 TWI0 — Two Wire Interface 0
20 TWI1 — Two Wire Interface 1
21 SPI0 — Serial Peripheral Interface 0
22 SSC — Synchronous Serial Controller
23 TC0_CH0 (TC0) — Timer/Counter 0 Channel 0
24 TC0_CH1 (TC0) — Timer/Counter 0 Channel 1
25 TC0_CH2 (TC0) — Timer/Counter 0 Channel 2
26 TC1_CH0 (TC1) — Timer/Counter 1 Channel 0
27 TC1_CH1 (TC1) — Timer/Counter 1 Channel 1
28 TC1_CH2 (TC1) — Timer/Counter 1 Channel 2
29 AFEC0 — Analog Front End 0
31 PWMC0 — Pulse Width Modulation 0
32 ICM — Integrity Check Monitor
33 ACC — Analog Comparator
34 USBHS — USB Host / Device Controller
35 MCAN0 — MCAN Controller 0
37 MCAN1 — MCAN Controller 1
39 GMAC — Ethernet MAC
40 AFEC1 — Analog Front End 1
41 TWI2 — Two Wire Interface 2
42 SPI1 — Serial Peripheral Interface 1
43 QSPI — Quad I/O Serial Peripheral Interface
44 UART2
45 UART3
46 UART4
47 TC2_CH0 (TC2) — Timer/Counter 2 Channel 0
48 TC2_CH1 (TC2) — Timer/Counter 2 Channel 1
49 TC2_CH2 (TC2) — Timer/Counter 2 Channel 2
50 TC3_CH0 (TC3) — Timer/Counter 3 Channel 0
51 TC3_CH1 (TC3) — Timer/Counter 3 Channel 1
52 TC3_CH2 (TC3) — Timer/Counter 3 Channel 2
53 MLB — MediaLB
56 AES
57 TRNG — True Random Generator
58 XDMAC — DMA
59 ISI — Camera Interface
60 PWMC1 — Pulse Width Modulation 1
62 SDRAMC — SDRAM Controller
63 RSWDT — Reinforced Secure Watchdog Timer
69 I2SC0 — Inter-IC Sound controller
70 I2SC1 — Inter-IC Sound controller

## Properties
SIGNATURES: JTAGID=0x05B3D03F, CHIPID_CIDR=0xA1020E00, CHIPID_EXID=0x00000001
LEGACY_INSTANCE_IDS: ID_TC0=TC0_INSTANCE_ID_CHANNEL0, ID_TC1=TC0_INSTANCE_ID_CHANNEL1, ID_TC2=TC0_INSTANCE_ID_CHANNEL2, ID_TC3=TC1_INSTANCE_ID_CHANNEL0, ID_TC4=TC1_INSTANCE_ID_CHANNEL1, ID_TC5=TC1_INSTANCE_ID_CHANNEL2, ID_TC6=TC2_INSTANCE_ID_CHANNEL0, ID_TC7=TC2_INSTANCE_ID_CHANNEL1, ID_TC8=TC2_INSTANCE_ID_CHANNEL2, ID_TC9=TC3_INSTANCE_ID_CHANNEL0, ID_TC10=TC3_INSTANCE_ID_CHANNEL1, ID_TC11=TC3_INSTANCE_ID_CHANNEL2
ELECTRICAL_CHARACTERISTICS: CHIP_FREQ_SLCK_RC_MIN=20000, CHIP_FREQ_SLCK_RC=32000 (Typical Slow Clock Internal RC frequency), CHIP_FREQ_SLCK_RC_MAX=44000, CHIP_FREQ_MAINCK_RC_4MHZ=4000000, CHIP_FREQ_MAINCK_RC_8MHZ=8000000, CHIP_FREQ_MAINCK_RC_12MHZ=12000000, CHIP_FREQ_CPU_MAX=300000000, CHIP_FREQ_XTAL_32K=32768, CHIP_FREQ_XTAL_12M=12000000, CHIP_FREQ_FWS_0=23000000 (Maximum operating frequency when FWS is 0), CHIP_FREQ_FWS_1=46000000 (Maximum operating frequency when FWS is 1), CHIP_FREQ_FWS_2=69000000 (Maximum operating frequency when FWS is 2), CHIP_FREQ_FWS_3=92000000 (Maximum operating frequency when FWS is 3), CHIP_FREQ_FWS_4=115000000 (Maximum operating frequency when FWS is 4), CHIP_FREQ_FWS_5=138000000 (Maximum operating frequency when FWS is 5), CHIP_FREQ_FWS_6=150000000 (Maximum operating frequency when FWS is 6), CHIP_FREQ_FWS_NUMBER=7 (Number of FWS ranges)

## Pinouts (pin number, pad)
TFBGA100: D8 PA0, C10 PA1, D10 PA2, F9 PA3, H10 PA4, H9 PA5, J2 PA7, K2 PA8, J9 PA9, K9 PA10, J8 PA11, K10 PA12, G5 PA13, H6 PA14, J6 PA15, J5 PA16, G1 PA17, G2 PA18, F1 PA19, F2 PA20, J1 PA21, J3 PA22, K5 PA23, K7 PA24, H7 PA25, K8 PA26, H8 PA27, A9 PA28, C7 PA30, A7 PA31, E1 PB0, E2 PB1, H1 PB2, H2 PB3, B9 PB4, C8 PB5, G8 PB6, E9 PB7, A2 PB8, A1 PB9, F8 PB12, B2 PB13, C1 PD0, D2 PD1, E3 PD2, B5 PD3, A5 PD4, D5 PD5, B6 PD6, A6 PD7, B7 PD8, B8 PD9, C9 PD10, D9 PD11, E10 PD12, E8 PD13, F10 PD14, B10 PD15, G9 PD16, J10 PD17, K6 PD18, K4 PD19, K3 PD20, H5 PD21, J4 PD22, G4 PD24, H3 PD25, G3 PD26, H4 PD27, J7 PD28, K1 PD30, B1 PD31, C3 VDDOUT, C2 VDDIN, D3 VREFN, D1 VREFP, G10 NRST, F7 TST, C5 VDDIO, F3 VDDIO, G7 VDDIO, A10 JTAGSEL, C6 VDDCORE, D6 VDDCORE, G6 VDDCORE, D7 VDDPLL, E5 VDDUTMII, A4 HSDM, B4 HSDP, E7 GND, F4 GND, F5 GND, F6 GND, D4 GNDANA, A8 GNDUTMI, C4 GNDPLLUSB, E4 GNDPLL, B3 VDDUTMIC, A3 VBG, E6 VDDPLLUSB
LQFP100: 72 PA0, 70 PA1, 66 PA2, 64 PA3, 55 PA4, 52 PA5, 24 PA7, 25 PA8, 54 PA9, 46 PA10, 44 PA11, 48 PA12, 27 PA13, 34 PA14, 33 PA15, 30 PA16, 16 PA17, 15 PA18, 14 PA19, 13 PA20, 21 PA21, 26 PA22, 31 PA23, 38 PA24, 40 PA25, 42 PA26, 50 PA27, 79 PA28, 82 PA30, 83 PA31, 12 PB0, 11 PB1, 17 PB2, 20 PB3, 74 PB4, 77 PB5, 57 PB6, 63 PB7, 98 PB8, 99 PB9, 61 PB12, 100 PB13, 1 PD0, 92 PD1, 91 PD2, 89 PD3, 88 PD4, 87 PD5, 85 PD6, 84 PD7, 80 PD8, 78 PD9, 71 PD10, 69 PD11, 65 PD12, 62 PD13, 59 PD14, 75 PD15, 56 PD16, 53 PD17, 49 PD18, 47 PD19, 45 PD20, 43 PD21, 41 PD22, 37 PD24, 35 PD25, 36 PD26, 32 PD27, 51 PD28, 23 PD30, 2 PD31, 4 VDDOUT, 5 VDDIN, 6 VREFN, 9 VREFP, 58 NRST, 60 TST, 19 VDDIO, 28 VDDIO, 68 VDDIO, 81 VDDIO, 73 JTAGSEL, 18 VDDCORE, 22 VDDCORE, 39 VDDCORE, 76 VDDCORE, 86 VDDPLL, 93 VDDUTMII, 94 HSDM, 95 HSDP, 3 GND, 7 GND, 8 GND, 10 GND, 29 GND, 67 GND, 96 VDDUTMIC, 97 VBG, 90 VDDPLLUSB

## Notices in the file
Copyright (c) 2017 Microchip Technology Inc.
SPDX-License-Identifier: Apache-2.0
Licensed under the Apache License, Version 2.0 (the "License");
you may not use this file except in compliance with the License.
You may obtain a copy of the License at
http://www.apache.org/licenses/LICENSE-2.0
Unless required by applicable law or agreed to in writing, software
distributed under the License is distributed on an "AS IS" BASIS,
WITHOUT WARRANTIES OR CONDITIONS OF ANY KIND, either express or implied.
See the License for the specific language governing permissions and
limitations under the License.
